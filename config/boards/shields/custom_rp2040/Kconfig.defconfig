## config/boards/shields/custom_rp2040/Kconfig.defconfig
```kconfig
if SHIELD_CUSTOM_RP2040

config ZMK_KEYBOARD_NAME
    default "Custom rp2040"

endif
```

## config/boards/shields/custom_rp2040/Kconfig.shield
```kconfig
config SHIELD_CUSTOM_RP2040
    def_bool $(shields_list_contains, custom_rp2040)
```
